## drivers/led_strip/Kconfig.ws2812
```kconfig
# Copyright (c) 2017 Linaro Limited
# Copyright (c) 2019 Nordic Semiconductor ASA
#
# SPDX-License-Identifier: Apache-2.0

# The following blog post is an excellent resource about pulse timing:
#
# https://wp.josh.com/2014/05/13/ws2812-neopixels-are-not-so-finicky-once-you-get-to-know-them/

config WS2812_STRIP_NRFX_PWM
	bool "PWM driver"
	depends on WS2812_STRIP
	depends on PWM 
	depends on HAS_HW_NRF_PWM0 \
		|| HAS_HW_NRF_PWM1 \
		|| HAS_HW_NRF_PWM2 \
		|| HAS_HW_NRF_PWM3
	select NRFX_PWM0 if HAS_HW_NRF_PWM0
	select NRFX_PWM1 if HAS_HW_NRF_PWM1
	select NRFX_PWM2 if HAS_HW_NRF_PWM2
	select NRFX_PWM3 if HAS_HW_NRF_PWM3
	help
	  The nrfx PWM driver requires only one pin, but significantly more
	  memory (16bits of overhead per bit of pixel data + 16 stop bits).
```

## dts/bindings/led_strip/worldsemi,ws2812-nrfx-pwm.yaml
```yaml
# Copyright (c) 2019, Nordic Semiconductor ASA
# SPDX-License-Identifier: Apache-2.0

description: |
  Worldsemi WS2812 LED strip, nrfx PWM binding

  Driver bindings for controlling a WS2812 or compatible LED
  strip with a PWM output on a device with nrfx drivers.

  Use of this driver implies an ~16x internal memory overhead (16 bits of
  driver RAM overhead per bit of pixel data + 16 stop bits).

compatible: "worldsemi,ws2812-nrfx-pwm"

include: [base.yaml, ws2812.yaml]
```
